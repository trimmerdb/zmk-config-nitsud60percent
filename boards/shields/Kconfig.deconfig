## boards/shields/Kconfig.deconfig
```kconfig
if SHEILD_nitsud60percent

config ZMK_KEYBOARD_NAME
    default "nitsud60percent"

endif
```

## boards/shields/nitsud/Kconfig.deconfig
```kconfig
if SHIELD_NITSUD

config ZMK_KEYBOARD_NAME
    default "nitsud"

config ZMK_RGB_UNDERGLOW
    default y
    select WS2812_STRIP         

config ZMK_RGB_UNDERGLOW_ON_START
    default y

endif # SHIELD_NITSUD
```

## boards/shields/nitsud/Kconfig.defconfig
```kconfig
if SHIELD_NITSUD

config ZMK_KEYBOARD_NAME
    default "nitsud"

config ZMK_PM_SOFT_OFF
	default y

config ZMK_RGB_UNDERGLOW
    default y
    select WS2812_STRIP
    select SPI

endif # SHIELD_NITSUD
```

## boards/shields/nitsud60percent/Kconfig.deconfig
```kconfig
if SHEILD_NITSUD60PERCENT

config ZMK_KEYBOARD_NAME
    default "nitsud60percent"

endif
```

## boards/shields/nitsud60percent/Kconfig.shield
```kconfig
config SHIELD_NITSUD60PERCENT
    def_bool $(shields_list_contains, nitsud60percent)
```

## config/boards/shields/Kconfig.shield
```kconfig
config SHIELD_nitsud60percent
    def_bool $(sheild_list_contains, nitsud60percent)
```

## config/west.yml
```yaml
manifest:
  defaults:
    revision: v0.3
  remotes:
    - name: zmkfirmware
      url-base: https://github.com/zmkfirmware
    - name: trimmerdb
      url-base: https://github.com/trimmerdb
    # Additional modules containing boards/shields/custom code can be listed here as well
    # See https://docs.zephyrproject.org/3.2.0/develop/west/manifest.html#projects
  projects:
    - name: zmk
      remote: zmkfirmware
      import: app/west.yml
    - name: zmk-config-nitsud60percent
      remote: trimmerdb
      revision: main
  self:
    path: config
```
